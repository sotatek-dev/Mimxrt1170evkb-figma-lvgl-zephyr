## CMakeLists.txt
```
cmake_minimum_required(VERSION 3.20.0)

set(BOARD "mimxrt1170_evk@B/mimxrt1176/cm7" CACHE STRING "Zephyr board target")
set(SHIELD "rk055hdmipi4ma0" CACHE STRING "Zephyr display shield")

find_package(Zephyr REQUIRED HINTS $ENV{ZEPHYR_BASE})
project(my_display_app)

target_sources(app PRIVATE src/main.c)
target_compile_definitions(app PRIVATE LV_LVGL_H_INCLUDE_SIMPLE=1)

set(APP_UI_RUNTIME_SOURCES
    src/app_ui.c
    src/ui_runtime/app_ui_helpers.c
    src/ui_runtime/home_screen_controller.c
    src/ui_runtime/drink_screen_controller.c
    src/ui_runtime/topping_screen_controller.c
    src/ui_runtime/order_screen_controller.c
    src/ui_runtime/final_screen_controller.c
)

set(UI_DIR ${CMAKE_CURRENT_SOURCE_DIR}/src/ui)
set(UI_SQUARELINE_FILE ${UI_DIR}/ui.c)
set(UI_LV_EDITOR_FILE_LIST ${UI_DIR}/file_list_gen.cmake)
set(UI_LV_EDITOR_ENTRY ${UI_DIR}/testtool.c)
set(UI_PUBLIC_INCLUDE_DIR ${UI_DIR}/include)
set(UI_PRIVATE_INCLUDE_DIR ${UI_DIR}/priv_include)
set(UI_SOURCE_DIR ${UI_DIR}/src)
set(UI_PRIVATE_SOURCE_DIR ${UI_DIR}/priv_src)
set(UI_GENERATED_DIR ${UI_SOURCE_DIR}/generated)
set(UI_CUSTOM_DIR ${UI_SOURCE_DIR}/custom)

if(EXISTS ${UI_SQUARELINE_FILE} AND EXISTS ${UI_DIR}/ui.h)
    file(GLOB_RECURSE UI_SQUARELINE_SOURCES CONFIGURE_DEPENDS
        ${UI_DIR}/*.c
    )

    target_include_directories(app PRIVATE
        ${UI_DIR}
    )

    target_sources(app PRIVATE ${UI_SQUARELINE_SOURCES})
    target_compile_definitions(app PRIVATE APP_HAS_SQUARELINE_UI=1)
elseif(EXISTS ${UI_LV_EDITOR_FILE_LIST})
    include(${UI_LV_EDITOR_FILE_LIST})
    include(${UI_DIR}/user_config.cmake OPTIONAL)

    target_include_directories(app PRIVATE
        ${CMAKE_CURRENT_SOURCE_DIR}/src
        ${CMAKE_CURRENT_SOURCE_DIR}/src/ui_runtime
        ${UI_DIR}
    )

    target_sources(app PRIVATE ${LV_EDITOR_PROJECT_SOURCES})
    if(EXISTS ${UI_LV_EDITOR_ENTRY} AND EXISTS ${UI_DIR}/testtool.h)
        target_compile_definitions(app PRIVATE APP_HAS_LV_EDITOR_UI=1)
    else()
        target_sources(app PRIVATE ${APP_UI_RUNTIME_SOURCES})
        target_compile_definitions(app PRIVATE APP_HAS_REAL_XML_UI=1)
    endif()
else()
    file(GLOB_RECURSE UI_SOURCES CONFIGURE_DEPENDS
        ${UI_SOURCE_DIR}/*.c
        ${UI_PRIVATE_SOURCE_DIR}/*.c
    )

    if(UI_SOURCES)
        target_include_directories(app PRIVATE
            ${UI_PUBLIC_INCLUDE_DIR}
            ${UI_PRIVATE_INCLUDE_DIR}
            ${UI_SOURCE_DIR}
            ${UI_GENERATED_DIR}
            ${UI_GENERATED_DIR}/guider_customer_fonts
            ${UI_GENERATED_DIR}/guider_fonts
            ${UI_GENERATED_DIR}/images
            ${UI_CUSTOM_DIR}
        )

        target_sources(app PRIVATE ${UI_SOURCES})
    endif()

    if(EXISTS ${UI_SOURCE_DIR}/ui_frame_1.c)
        target_compile_definitions(app PRIVATE APP_HAS_FRAME_UI=1)
    endif()

    if(EXISTS ${UI_GENERATED_DIR}/gui_guider.c AND
       EXISTS ${UI_GENERATED_DIR}/gui_guider.h AND
       EXISTS ${UI_GENERATED_DIR}/events_init.c AND
       EXISTS ${UI_GENERATED_DIR}/events_init.h)
        target_compile_definitions(app PRIVATE APP_HAS_GENERATED_UI=1)
    endif()
endif()
```

## Kconfig
```
# Private config options for my display app

# Copyright (c) 2025 NXP
# SPDX-License-Identifier: Apache-2.0

mainmenu "My display application"

source "Kconfig.zephyr"
```

## prj.conf
```kconfig
# App config. Change values here, or run `west build -t menuconfig`
# after configuring the build directory.

CONFIG_DISPLAY=y
CONFIG_LOG=y
CONFIG_LOG_DEFAULT_LEVEL=3

# Generated UI screens use more stack and LVGL heap than the basic app.
CONFIG_MAIN_STACK_SIZE=131072

CONFIG_LVGL=y
CONFIG_LV_USE_LOG=y
CONFIG_LV_LOG_LEVEL_ERROR=y
CONFIG_LV_Z_MEM_POOL_SIZE=262144
CONFIG_LV_USE_OBJ_NAME=y

# The RK055HDMIPI4MA0 panel is physically 720x1280. The UI is authored as
# 1280x720, so LVGL renders landscape and eLCDIF/PXP rotates the frame to
# the panel. PXP rotation is counter-clockwise; LVGL rotation 90 maps to
# eLCDIF PXP rotate 270.
CONFIG_DMA=y
CONFIG_MCUX_PXP=y
CONFIG_MCUX_ELCDIF_PXP=y
CONFIG_MCUX_ELCDIF_PXP_ROTATE_270=y
CONFIG_LV_Z_FULL_REFRESH=y

CONFIG_LV_USE_ARC=y
CONFIG_LV_USE_BAR=y
CONFIG_LV_USE_BUTTON=y
CONFIG_LV_USE_CALENDAR=y
CONFIG_LV_USE_CALENDAR_HEADER_ARROW=y
CONFIG_LV_USE_CHART=y
CONFIG_LV_USE_CHECKBOX=y
CONFIG_LV_USE_DROPDOWN=y
CONFIG_LV_USE_IMAGE=y
CONFIG_LV_USE_KEYBOARD=y
CONFIG_LV_USE_SCALE=y
CONFIG_LV_USE_SLIDER=y
CONFIG_LV_USE_SWITCH=y
CONFIG_LV_USE_TABVIEW=y
CONFIG_LV_USE_TEXTAREA=y

CONFIG_LV_FONT_MONTSERRAT_12=y
CONFIG_LV_FONT_MONTSERRAT_14=y
CONFIG_LV_FONT_MONTSERRAT_46=y
```

## src/main.c
```c
/*
 * SPDX-License-Identifier: Apache-2.0
 */

#include <limits.h>

#include <lvgl.h>
#include <zephyr/device.h>
#include <zephyr/drivers/display.h>
#include <zephyr/kernel.h>
#include <zephyr/logging/log.h>
#include <zephyr/sys/util.h>

#ifdef APP_HAS_FRAME_UI
#include "ui_frame_1.h"
#endif

#ifdef APP_HAS_SQUARELINE_UI
#include "ui.h"
#endif

#ifdef APP_HAS_LV_EDITOR_UI
#include "testtool.h"
#endif

#ifdef APP_HAS_REAL_XML_UI
#include "app_ui.h"
#endif

#ifdef APP_HAS_GENERATED_UI
#include "gui_guider.h"
#include "events_init.h"
#if __has_include("custom.h")
#include "custom.h"
#define APP_HAS_CUSTOM_UI 1
#endif
#endif

LOG_MODULE_REGISTER(app, CONFIG_LOG_DEFAULT_LEVEL);

#define LVGL_MAX_SLEEP_MS 5U
#define APP_DISPLAY_ROTATION LV_DISPLAY_ROTATION_90

BUILD_ASSERT(IS_ENABLED(CONFIG_MCUX_ELCDIF_PXP) &&
	     IS_ENABLED(CONFIG_MCUX_ELCDIF_PXP_ROTATE_270),
	     "Landscape LVGL rotation requires eLCDIF PXP rotate 270");

#ifdef APP_HAS_GENERATED_UI
lv_ui guider_ui;
#endif

static void app_display_configure_landscape(void)
{
	lv_display_t *display = lv_display_get_default();

	if (display == NULL) {
		LOG_ERR("LVGL display is not ready");
		return;
	}

	lv_display_set_rotation(display, APP_DISPLAY_ROTATION);
	LOG_INF("LVGL logical display: %dx%d",
		(int)lv_display_get_horizontal_resolution(display),
		(int)lv_display_get_vertical_resolution(display));
}

#ifdef APP_HAS_SQUARELINE_UI
struct app_home_slider_binding {
	const char *name;
	int32_t *value;
};

static lv_obj_t *home_status_label;
static int32_t home_strength;
static int32_t home_length;

static struct app_home_slider_binding home_strength_binding = {
	.name = "strength",
	.value = &home_strength,
};

static struct app_home_slider_binding home_length_binding = {
	.name = "length",
	.value = &home_length,
};

static void app_home_status_update(void)
{
	if (home_status_label != NULL) {
		lv_label_set_text_fmt(home_status_label, "Strength %d | %d ml",
				      (int)home_strength, (int)(home_length * 100));
	}
}

static void app_home_slider_event_cb(lv_event_t *event)
{
	struct app_home_slider_binding *binding = lv_event_get_user_data(event);
	lv_obj_t *slider = lv_event_get_target(event);

	*binding->value = lv_slider_get_value(slider);
	app_home_status_update();
	LOG_INF("Home %s slider: %d", binding->name, (int)*binding->value);
}

static void app_ui_click_event_cb(lv_event_t *event)
{
	LOG_INF("UI touch: %s", (char *)lv_event_get_user_data(event));
}

static void app_squareline_bind_home_test(void)
{
	lv_obj_t *strength_slider;
	lv_obj_t *length_slider;
	lv_obj_t *start_button;
	lv_obj_t *extract_button;

	if (ui_Home_header_header4 == NULL ||
	    ui_Home_home_sliders_home_slider == NULL ||
	    ui_Home_home_sliders_home_slider1 == NULL ||
	    ui_Splash_screen_CTA_container_CTA_container9 == NULL ||
	    ui_Home_CTA_container_CTA_container == NULL) {
		LOG_WRN("SquareLine home test objects are not ready");
		return;
	}

	home_status_label = ui_comp_get_child(
		ui_Home_header_header4,
		UI_COMP_CONTAINER_HEADER_CONTAINER_HEADER_PANEL_LABEL_TITLE);
	strength_slider = ui_comp_get_child(
		ui_Home_home_sliders_home_slider,
		UI_COMP_CONTAINER_HOME_SLIDERS_CONTAINER_STRENGTH_CONTAINER_SLIDER_SLIDER_STRENGTH);
	length_slider = ui_comp_get_child(
		ui_Home_home_sliders_home_slider1,
		UI_COMP_CONTAINER_HOME_SLIDERS_CONTAINER_LENGTH_CONTAINER_SLIDER_SLIDER_LENGTH);
	start_button = ui_comp_get_child(
		ui_Splash_screen_CTA_container_CTA_container9,
		UI_COMP_CONTAINER_CTA_CONTAINER_PANEL_CIRCLE_PANEL);
	extract_button = ui_comp_get_child(
		ui_Home_CTA_container_CTA_container,
		UI_COMP_CONTAINER_CTA_CONTAINER_PANEL_CIRCLE_PANEL);

	if (home_status_label == NULL || strength_slider == NULL ||
	    length_slider == NULL || start_button == NULL ||
	    extract_button == NULL) {
		LOG_WRN("SquareLine home test binding is incomplete");
		return;
	}

	home_strength = lv_slider_get_value(strength_slider);
	home_length = lv_slider_get_value(length_slider);
	app_home_status_update();

	lv_obj_add_event_cb(strength_slider, app_home_slider_event_cb,
			    LV_EVENT_VALUE_CHANGED, &home_strength_binding);
	lv_obj_add_event_cb(length_slider, app_home_slider_event_cb,
			    LV_EVENT_VALUE_CHANGED, &home_length_binding);
	lv_obj_add_event_cb(start_button, app_ui_click_event_cb,
			    LV_EVENT_CLICKED, "splash start");
	lv_obj_add_event_cb(extract_button, app_ui_click_event_cb,
			    LV_EVENT_CLICKED, "home extract");
}
#endif

#ifdef APP_HAS_LV_EDITOR_UI
static lv_obj_t *editor_button_status_label;
static uint32_t editor_button_click_count;

static lv_obj_t *app_find_child_by_type(lv_obj_t *parent,
					const lv_obj_class_t *class_p)
{
	uint32_t child_count = lv_obj_get_child_count(parent);

	for (uint32_t index = 0U; index < child_count; index++) {
		lv_obj_t *child = lv_obj_get_child(parent, index);

		if (lv_obj_check_type(child, class_p)) {
			return child;
		}
	}

	return NULL;
}

static void app_editor_button_status_update(void)
{
	if (editor_button_status_label != NULL) {
		lv_label_set_text_fmt(editor_button_status_label, "Button clicks: %u",
				      (unsigned int)editor_button_click_count);
	}
}

static void app_editor_button_event_cb(lv_event_t *event)
{
	lv_obj_t *button = lv_event_get_target(event);

	editor_button_click_count++;
	lv_obj_set_style_bg_color(button,
				  lv_color_hex((editor_button_click_count % 2U) != 0U ?
					       0x0b7a53 : 0x2c2c2c),
				  0);
	app_editor_button_status_update();
	LOG_INF("LVGL Editor button clicks: %u",
		(unsigned int)editor_button_click_count);
}

static void app_editor_bind_hello_test(lv_obj_t *hello_screen)
{
	lv_obj_t *button;

	if (hello_screen == NULL) {
		LOG_WRN("LVGL Editor hello screen is not ready");
		return;
	}

	button = app_find_child_by_type(hello_screen, &lv_button_class);
	if (button == NULL) {
		LOG_WRN("LVGL Editor hello button was not found");
		return;
	}

	editor_button_status_label = lv_label_create(hello_screen);
	lv_obj_set_align(editor_button_status_label, LV_ALIGN_TOP_MID);
	lv_obj_set_y(editor_button_status_label, 36);
	lv_obj_set_style_text_color(editor_button_status_label,
				    lv_color_hex(0xffffff), 0);

	app_editor_button_status_update();
	lv_obj_add_event_cb(button, app_editor_button_event_cb,
			    LV_EVENT_CLICKED, NULL);
}
#endif

int main(void)
{
	const struct device *display_dev = DEVICE_DT_GET(DT_CHOSEN(zephyr_display));

	if (!device_is_ready(display_dev)) {
		LOG_ERR("Display device is not ready");
		return 0;
	}

	app_display_configure_landscape();

#ifdef APP_HAS_FRAME_UI
	ui_frame_1_init();
	ui_frame_1_button_display();
	ui_frame_1_load();
#elif defined(APP_HAS_SQUARELINE_UI)
	ui_init();
	app_squareline_bind_home_test();
#elif defined(APP_HAS_LV_EDITOR_UI)
	lv_obj_t *hello_screen;

	testtool_init(NULL);
	hello_screen = hello_create();
	if (hello_screen != NULL) {
		lv_screen_load(hello_screen);
	}
	app_editor_bind_hello_test(hello_screen);
#elif defined(APP_HAS_REAL_XML_UI)
	app_ui_start();
#elif defined(APP_HAS_GENERATED_UI)
	setup_ui(&guider_ui);
	events_init(&guider_ui);
#ifdef APP_HAS_CUSTOM_UI
	custom_init(&guider_ui);
#endif
#else
	LOG_WRN("No UI source found under src/ui");
#endif

	(void)lv_timer_handler();
	(void)display_blanking_off(display_dev);

#if defined(APP_HAS_FRAME_UI) || defined(APP_HAS_SQUARELINE_UI) || \
	defined(APP_HAS_LV_EDITOR_UI) || defined(APP_HAS_REAL_XML_UI) || \
	defined(APP_HAS_GENERATED_UI)
	LOG_INF("LVGL UI started");
#else
	LOG_INF("LVGL shell started");
#endif

	while (1) {
		uint32_t sleep_ms = lv_timer_handler();

		k_msleep(MIN(sleep_ms, LVGL_MAX_SLEEP_MS));
	}

	return 0;
}
```

## src/app_ui.c
```c
/**
 * @file app_ui.c
 */

#include "app_ui.h"
#include "ui_runtime/app_ui_internal.h"

static struct app_ui_context app_ctx;

void app_ui_load_home_screen(void)
{
    app_order_screen_stop();

    if (app_ctx.screens.home != NULL) {
        lv_screen_load(app_ctx.screens.home);
    }
}

void app_ui_load_drink_screen(void)
{
    app_order_screen_stop();

    if (app_ctx.screens.drink != NULL) {
        lv_screen_load(app_ctx.screens.drink);
    }
}

void app_ui_select_drink(const struct app_drink * drink)
{
    app_ctx.selected_drink = drink != NULL ? drink : &app_drinks[0];
    app_order_screen_stop();

#if APP_HAS_TOPPING_SCREEN
    if (app_ctx.screens.topping != NULL) {
        app_topping_screen_show(&app_ctx);
        return;
    }

    LOG_WRN("toppingscreen was generated but could not be created");
#else
    LOG_WRN("toppingscreen is not generated; loading brewing screen directly");
#endif

    app_ui_start_order_screen();
}

void app_ui_start_order_screen(void)
{
    app_order_screen_start(&app_ctx);

    if (app_ctx.screens.order != NULL) {
        lv_screen_load(app_ctx.screens.order);
    }
}

void app_ui_load_final_screen(void)
{
    if (app_ctx.screens.final != NULL) {
        lv_screen_load(app_ctx.screens.final);
    }
}

void app_ui_start(void)
{
    app_ui_context_init(&app_ctx);
    real_xml_project_init(NULL);

    app_ctx.screens.home = homescreen_create();
    app_ctx.screens.drink = drinkscreen_create();
#if APP_HAS_TOPPING_SCREEN
    app_ctx.screens.topping = toppingscreen_create();
#endif
    app_ctx.screens.order = orderscreen_create();
    app_ctx.screens.final = finalscreen_create();

    app_order_screen_bind(&app_ctx);
    app_home_screen_bind(&app_ctx);
    app_drink_screen_bind(&app_ctx);
    app_topping_screen_bind(&app_ctx);
    app_final_screen_bind(&app_ctx);

    if (app_ctx.screens.home != NULL) {
        lv_screen_load(app_ctx.screens.home);
    }
}
```

## src/app_ui.h
```c
/**
 * @file app_ui.h
 */

#ifndef APP_UI_H
#define APP_UI_H

#ifdef __cplusplus
extern "C" {
#endif

void app_ui_start(void);

#ifdef __cplusplus
} /*extern "C"*/
#endif

#endif /*APP_UI_H*/
```
